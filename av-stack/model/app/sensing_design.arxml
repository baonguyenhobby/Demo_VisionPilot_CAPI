AUTOSAR XML (schema 00049)
package /SensingApp
  process design SensingDesign: executable=sensingd
package /SensingApp/exe
  executable sensingd: category=APPLICATION_LEVEL, logging-behavior=USES-LOGGING, reporting-behavior=REPORTS-EXECUTION-STATE
    root sw component prototype sn_root: application-type=Sensing
package /SensingApp/swc
  adaptive application sw component type Sensing  # Sensor abstraction: camera capture and mounting-specific preprocessing. Publishes frames by reference into a shared-memory ring. Radar and lidar would add provided ports here.
    provide port PPort_CameraFrame: provided-interface=CameraFrameService  # Frame descriptors out. REPORTS-EXECUTION-STATE matters here: this process must reach kRunning, and so have created the ring, before Perception maps it.

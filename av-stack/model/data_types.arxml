AUTOSAR XML (schema 00049)
package /AvTypes/DataTypes
  5 x std cpp implementation data type, all with type-emitter=TYPE_EMITTER_ARA:
    FrameDescriptor: category=STRUCTURE  # Reference to one camera capture held in the shared-memory ring. Carries no pixel data.
      namespaces:
        symbol props av
        symbol props vp
        symbol props cm
      13 x cpp implementation data type element:
        timestampNs: type-reference=uint64_t  # Capture time, not publish time. Everything downstream ages the frame from here.
        seqCounter: type-reference=uint32_t
        segmentInstanceId: type-reference=uint32_t  # New value each time Sensing creates the shared segment. A consumer holding a different value must re-map before reading.
        warpedSlot: type-reference=uint16_t  # Ring index of the BEV-warped image.
        resizedSlot: type-reference=uint16_t  # Ring index of the plain-resized image.
        generation: type-reference=uint32_t  # Seqlock counter. Re-read the slot header after consuming; a changed value means the writer lapped the reader and the frame must be discarded.
        width: type-reference=uint16_t
        height: type-reference=uint16_t
        stride: type-reference=uint32_t  # Row stride in bytes. Explicit because a DMA-buf allocation on the Orin is not guaranteed to be tightly packed.
        rawWidth: type-reference=uint16_t  # Width of the ORIGINAL capture, before the 2:1 top-crop and the resize to network input. Perception needs it to build the resized-pixel to world homography; width/height above are the network size and cannot substitute.
        rawHeight: type-reference=uint16_t  # Height of the ORIGINAL capture. With rawWidth this determines the top-crop and the scale factors in InferencePipeline::set_H_resized.
        pixelFormat: type-reference=uint8_t  # 0 = BGR8 (OpenCV native). Reserved for the OAK-D and for NV12 capture paths.
        valid: type-reference=uint8_t
    DrivingState: category=STRUCTURE  # Fused lane-relative state and CIPO estimate from one perception cycle.
      namespaces:
        symbol props av
        symbol props vp
        symbol props cm
      13 x cpp implementation data type element:
        timestampNs: type-reference=uint64_t  # Copied from the FrameDescriptor that produced it, so age is measured from capture and not from perception's own publish.
        seqCounter: type-reference=uint32_t  # Planning's staleness check keys on this: an unchanged counter is a stalled producer even when the timestamp still looks fresh.
        cteM: type-reference=float  # Cross-track error, m (LateralFusionEstimate.cte_m).
        epsiRad: type-reference=float  # Heading error, rad (yaw_rad).
        kappa: type-reference=float  # Road curvature, 1/m.
        cteRateMps: type-reference=float
        yawRateRps: type-reference=float
        rawCteM: type-reference=float  # Unfiltered cross-track error, for logging and the visualization overlay only. Never an input to planning.
        pathValid: type-reference=uint8_t
        hasCipo: type-reference=uint8_t  # Tracker-based: true only when the filter tracks a target closer than D_MAX. cipo_raw_found alone must not gate the planner.
        cipoDistanceM: type-reference=float
        cipoVelocityMps: type-reference=float  # Negative = approaching. When hasCipo is 0 the planner substitutes the configured speed limit; this field is then meaningless, not zero.
        valid: type-reference=uint8_t
    SteeringHorizon: category=ARRAY, array-size=20, cpp-template-argument=float  # Fixed 20-step tyre-angle sequence in radians. N matches LateralPlanner's horizon.
      namespaces:
        symbol props av
        symbol props vp
        symbol props cm
    Trajectory: category=STRUCTURE  # One planning cycle: longitudinal acceleration, the steering horizon, the ego speed the plan was computed against, and the worst active warning.
      namespaces:
        symbol props av
        symbol props vp
        symbol props cm
      6 x cpp implementation data type element:
        timestampNs: type-reference=uint64_t  # Propagated from the DrivingState that produced it, and thence from capture.
        seqCounter: type-reference=uint32_t
        accelerationMps2: type-reference=float  # Longitudinal acceleration request, m/s^2 (Plan.acceleration).
        egoSpeedMps: type-reference=float  # Ego speed the plan was computed against, m/s. Not a measurement Control should act on; it exists so a consumer can correlate a trajectory with the speed that produced it, and so the overlay can show a speed without Perception taking a VehicleStatus dependency.
        steeringHorizonRad: type-reference=SteeringHorizon  # Plan.steering. Control applies index 1, as upstream main() does; the remainder is what it follows if planning stops.
        warning: type-reference=uint8_t  # 0 None, 1 FCW, 2 AEB, 3 LLDW, 4 RLDW. Plan.warnings is a list; the most severe one wins, and severity is not numeric order — a brake demand must never be masked by the warning that preceded it.
    VehicleSpeed: category=STRUCTURE  # Ego longitudinal speed with validity flag.
      namespaces:
        symbol props av
        symbol props vp
        symbol props cm
      4 x cpp implementation data type element:
        timestampNs: type-reference=uint64_t
        seqCounter: type-reference=uint32_t
        speedMps: type-reference=float  # Metres per second. float32: the planner works in double, but the sensor resolution does not justify 8 bytes on the wire.
        valid: type-reference=uint8_t

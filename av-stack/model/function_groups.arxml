AUTOSAR XML (schema 00049)
package /FunctionGroups/AvPilot
  mode declaration group AvPilotFG: initial-mode=Off
    5 x mode:
      Off
      Init
      Driving
      Degraded
      Safe
  function group set FunctionGroupsSet
    function-groups:
      mode declaration group prototype AvPilotFG: type=AvPilotFG

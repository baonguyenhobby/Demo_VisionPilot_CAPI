AUTOSAR XML (schema 00049)
package /AvDeployment
  process to machine mapping set mappingSet
    4 x process to machine mapping, all with machine=Machine1:
      SensingMapping: process=sensing_process
      PerceptionMapping: process=perception_process
      PlanningMapping: process=planning_process
      ControlMapping: process=control_process
  12 x dlt log channel to process mapping:
    dlt_sensing_default: dlt-log-channel=default, process=sensing_process
    dlt_sensing_com: dlt-log-channel=com, process=sensing_process
    dlt_sensing_vpa: dlt-log-channel=vpa, process=sensing_process
    dlt_perception_default: dlt-log-channel=default, process=perception_process
    dlt_perception_com: dlt-log-channel=com, process=perception_process
    dlt_perception_vpa: dlt-log-channel=vpa, process=perception_process
    dlt_planning_default: dlt-log-channel=default, process=planning_process
    dlt_planning_com: dlt-log-channel=com, process=planning_process
    dlt_planning_vpa: dlt-log-channel=vpa, process=planning_process
    dlt_control_default: dlt-log-channel=default, process=control_process
    dlt_control_com: dlt-log-channel=com, process=control_process
    dlt_control_vpa: dlt-log-channel=vpa, process=control_process
  9 x someip service instance to machine mapping, all with communication-connector=CommunicationConnector1:
    CameraFrame_Provided_toMachine: service-instance=ProvidedInstance_CameraFrame, udp-port=30503
    CameraFrame_Required_toMachine: service-instance=RequiredInstance_CameraFrame
    DrivingState_Provided_toMachine: service-instance=ProvidedInstance_DrivingState, udp-port=30504
    DrivingState_Required_toMachine: service-instance=RequiredInstance_DrivingState
    Trajectory_Provided_toMachine: service-instance=ProvidedInstance_Trajectory, udp-port=30505
    Trajectory_Required_toMachine: service-instance=RequiredInstance_Trajectory
    Trajectory_Viz_Required_toMachine: service-instance=RequiredInstance_Trajectory_Viz
    VehicleStatus_Provided_toMachine: service-instance=ProvidedInstance_VehicleStatus, udp-port=30501
    VehicleStatus_Required_toMachine: service-instance=RequiredInstance_VehicleStatus
  4 x process:
    sensing_process: design=SensingDesign, executable=sensingd, state-dependent-startup-config{function-group-state=[AvPilotFG.Driving, AvPilotFG.Degraded], resource-group=DefaultResourceGroup, startup-config=sensing_config}
      process state machine processStateMachine: type=ProcessStateMachine
    perception_process: design=PerceptionDesign, executable=perceptiond, state-dependent-startup-config{function-group-state=[AvPilotFG.Driving, AvPilotFG.Degraded], resource-group=DefaultResourceGroup, startup-config=perception_config}
      process state machine processStateMachine: type=ProcessStateMachine
    planning_process: design=PlanningDesign, executable=planningd, state-dependent-startup-config{function-group-state=AvPilotFG.Driving, resource-group=DefaultResourceGroup, startup-config=planning_config}
      process state machine processStateMachine: type=ProcessStateMachine
    control_process: design=ControlDesign, executable=controld, state-dependent-startup-config{function-group-state=[AvPilotFG.Driving, AvPilotFG.Degraded, AvPilotFG.Safe], resource-group=DefaultResourceGroup, startup-config=control_config}
      process state machine processStateMachine: type=ProcessStateMachine
  startup config set startup_set
    4 x startup config, all with scheduling-policy=RR, termination-behavior=PROCESS-IS-NOT-SELF-TERMINATING:
      control_config: scheduling-priority=22
      sensing_config: scheduling-priority=18
      planning_config: scheduling-priority=14
      perception_config: scheduling-priority=12
  9 x service instance to port prototype mapping:
    Sensing_CameraFrame_toPort: port-prototype=sn_root.PPort_CameraFrame, process-design=SensingDesign, process=sensing_process, service-instance=ProvidedInstance_CameraFrame
    Perception_CameraFrame_toPort: port-prototype=pc_root.RPort_CameraFrame, process-design=PerceptionDesign, process=perception_process, service-instance=RequiredInstance_CameraFrame
    Perception_DrivingState_toPort: port-prototype=pc_root.PPort_DrivingState, process-design=PerceptionDesign, process=perception_process, service-instance=ProvidedInstance_DrivingState
    Planning_DrivingState_toPort: port-prototype=pl_root.RPort_DrivingState, process-design=PlanningDesign, process=planning_process, service-instance=RequiredInstance_DrivingState
    Planning_Trajectory_toPort: port-prototype=pl_root.PPort_Trajectory, process-design=PlanningDesign, process=planning_process, service-instance=ProvidedInstance_Trajectory
    Control_Trajectory_toPort: port-prototype=ct_root.RPort_Trajectory, process-design=ControlDesign, process=control_process, service-instance=RequiredInstance_Trajectory
    Perception_Trajectory_Viz_toPort: port-prototype=pc_root.RPort_Trajectory, process-design=PerceptionDesign, process=perception_process, service-instance=RequiredInstance_Trajectory_Viz
    Control_VehicleStatus_toPort: port-prototype=ct_root.PPort_VehicleStatus, process-design=ControlDesign, process=control_process, service-instance=ProvidedInstance_VehicleStatus
    Planning_VehicleStatus_toPort: port-prototype=pl_root.RPort_VehicleStatus, process-design=PlanningDesign, process=planning_process, service-instance=RequiredInstance_VehicleStatus
package /AvGrants
  com offer service grant offer_cameraframe: service-instance=ProvidedInstance_CameraFrame
  com event grant send_cameraframe_event: service-instance=ProvidedInstance_CameraFrame, service-deployment=FrameEvent
  com find service grant find_cameraframe: service-instance=RequiredInstance_CameraFrame
  com event grant receive_cameraframe_event: service-instance=RequiredInstance_CameraFrame, service-deployment=FrameEvent
  com offer service grant offer_drivingstate: service-instance=ProvidedInstance_DrivingState
  com event grant send_drivingstate_event: service-instance=ProvidedInstance_DrivingState, service-deployment=DrivingStateEvent
  com find service grant find_drivingstate: service-instance=RequiredInstance_DrivingState
  com event grant receive_drivingstate_event: service-instance=RequiredInstance_DrivingState, service-deployment=DrivingStateEvent
  com offer service grant offer_trajectory: service-instance=ProvidedInstance_Trajectory
  com event grant send_trajectory_event: service-instance=ProvidedInstance_Trajectory, service-deployment=TrajectoryEvent
  com find service grant find_trajectory: service-instance=RequiredInstance_Trajectory
  com event grant receive_trajectory_event: service-instance=RequiredInstance_Trajectory, service-deployment=TrajectoryEvent
  com find service grant find_trajectory_viz: service-instance=RequiredInstance_Trajectory_Viz
  com event grant receive_trajectory_viz_event: service-instance=RequiredInstance_Trajectory_Viz, service-deployment=TrajectoryEvent
  com offer service grant offer_vehiclestatus: service-instance=ProvidedInstance_VehicleStatus
  com event grant send_vehiclestatus_event: service-instance=ProvidedInstance_VehicleStatus, service-deployment=SpeedEvent
  com find service grant find_vehiclestatus: service-instance=RequiredInstance_VehicleStatus
  com event grant receive_vehiclestatus_event: service-instance=RequiredInstance_VehicleStatus, service-deployment=SpeedEvent

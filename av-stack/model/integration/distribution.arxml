AUTOSAR XML (schema 00049)
package /ISOFT/Development/SoftwareClustersAv/VER_100
  software cluster AvPilotCluster: category=APPLICATION_LAYER, claimed-function-group=AvPilotFG, contained-ar-element=[sensingd, perceptiond, planningd, controld], contained-process=[sensing_init_process, perception_init_process, planning_init_process, control_init_process, sensing_process, perception_process, planning_process, control_process], vendor-id=1, version=1.0.0

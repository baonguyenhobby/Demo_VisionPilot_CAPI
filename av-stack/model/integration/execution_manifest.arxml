AUTOSAR XML (schema 00049)
package /AvDeployment
  8 x process:
    sensing_init_process: design=SensingDesign, executable=sensingd, state-dependent-startup-config{function-group-state=AvPilotFG.Init, resource-group=DefaultResourceGroup, startup-config=sensing_init_config}
      process state machine processStateMachine: type=ProcessStateMachine
    perception_init_process: design=PerceptionDesign, executable=perceptiond, state-dependent-startup-config{function-group-state=AvPilotFG.Init, resource-group=DefaultResourceGroup, startup-config=perception_init_config}
      process state machine processStateMachine: type=ProcessStateMachine
    planning_init_process: design=PlanningDesign, executable=planningd, state-dependent-startup-config{function-group-state=AvPilotFG.Init, resource-group=DefaultResourceGroup, startup-config=planning_init_config}
      process state machine processStateMachine: type=ProcessStateMachine
    control_init_process: design=ControlDesign, executable=controld, state-dependent-startup-config{function-group-state=AvPilotFG.Init, resource-group=DefaultResourceGroup, startup-config=control_init_config}
      process state machine processStateMachine: type=ProcessStateMachine
    sensing_process: design=SensingDesign, executable=sensingd, state-dependent-startup-config{function-group-state=[AvPilotFG.Driving, AvPilotFG.Degraded], resource-group=DefaultResourceGroup, startup-config=sensing_config}
      process state machine processStateMachine: type=ProcessStateMachine
    perception_process: design=PerceptionDesign, executable=perceptiond, state-dependent-startup-config{function-group-state=[AvPilotFG.Driving, AvPilotFG.Degraded], resource-group=DefaultResourceGroup, startup-config=perception_config}
      process state machine processStateMachine: type=ProcessStateMachine
    planning_process: design=PlanningDesign, executable=planningd, state-dependent-startup-config{function-group-state=AvPilotFG.Driving, resource-group=DefaultResourceGroup, startup-config=planning_config}
      process state machine processStateMachine: type=ProcessStateMachine
    control_process: design=ControlDesign, executable=controld, state-dependent-startup-config{function-group-state=[AvPilotFG.Driving, AvPilotFG.Degraded, AvPilotFG.Safe], resource-group=DefaultResourceGroup, startup-config=control_config}
      process state machine processStateMachine: type=ProcessStateMachine
  startup config set startup_set
    8 x startup config, all with scheduling-policy=RR:
      sensing_init_config: process-argument=--phase=init, scheduling-priority=18, termination-behavior=PROCESS-IS-SELF-TERMINATING, timeout={enter-timeout-value=10.0, exit-timeout-value=10.0}
      perception_init_config: process-argument=--phase=init, scheduling-priority=12, termination-behavior=PROCESS-IS-SELF-TERMINATING, timeout={enter-timeout-value=10.0, exit-timeout-value=10.0}
      planning_init_config: process-argument=--phase=init, scheduling-priority=14, termination-behavior=PROCESS-IS-SELF-TERMINATING, timeout={enter-timeout-value=10.0, exit-timeout-value=10.0}
      control_init_config: process-argument=--phase=init, scheduling-priority=22, termination-behavior=PROCESS-IS-SELF-TERMINATING, timeout={enter-timeout-value=10.0, exit-timeout-value=10.0}
      sensing_config: process-argument=--phase=run, scheduling-priority=18, termination-behavior=PROCESS-IS-NOT-SELF-TERMINATING
      perception_config: process-argument=--phase=run, scheduling-priority=12, termination-behavior=PROCESS-IS-NOT-SELF-TERMINATING
      planning_config: process-argument=--phase=run, scheduling-priority=14, termination-behavior=PROCESS-IS-NOT-SELF-TERMINATING
      control_config: process-argument=--phase=run, scheduling-priority=22, termination-behavior=PROCESS-IS-NOT-SELF-TERMINATING

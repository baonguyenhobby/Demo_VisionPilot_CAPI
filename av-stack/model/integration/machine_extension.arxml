AUTOSAR XML (schema 00049)
package /ISOFT/Development
  machine Machine1
    module-instantiations:
      4 x log and trace instantiation:
        sensing_log
          dlt log channel default: application-id=sens, context-id=#DFT, log-trace-default-log-level=DEBUG, log-trace-file-path=/var/redirected/, log-trace-log-modes=[CONSOLE, FILE, NETWORK]
          dlt log channel com: application-id=sens, context-id=#COM, log-trace-default-log-level=DEBUG, log-trace-file-path=/var/redirected/, log-trace-log-modes=[CONSOLE, FILE, NETWORK]
          dlt log channel vpa: application-id=sens, context-id=#VPA, log-trace-default-log-level=DEBUG, log-trace-file-path=/var/redirected/, log-trace-log-modes=[CONSOLE, FILE, NETWORK]
        perception_log
          dlt log channel default: application-id=perc, context-id=#DFT, log-trace-default-log-level=DEBUG, log-trace-file-path=/var/redirected/, log-trace-log-modes=[CONSOLE, FILE, NETWORK]
          dlt log channel com: application-id=perc, context-id=#COM, log-trace-default-log-level=DEBUG, log-trace-file-path=/var/redirected/, log-trace-log-modes=[CONSOLE, FILE, NETWORK]
          dlt log channel vpa: application-id=perc, context-id=#VPA, log-trace-default-log-level=DEBUG, log-trace-file-path=/var/redirected/, log-trace-log-modes=[CONSOLE, FILE, NETWORK]
        planning_log
          dlt log channel default: application-id=plan, context-id=#DFT, log-trace-default-log-level=DEBUG, log-trace-file-path=/var/redirected/, log-trace-log-modes=[CONSOLE, FILE, NETWORK]
          dlt log channel com: application-id=plan, context-id=#COM, log-trace-default-log-level=DEBUG, log-trace-file-path=/var/redirected/, log-trace-log-modes=[CONSOLE, FILE, NETWORK]
          dlt log channel vpa: application-id=plan, context-id=#VPA, log-trace-default-log-level=DEBUG, log-trace-file-path=/var/redirected/, log-trace-log-modes=[CONSOLE, FILE, NETWORK]
        control_log
          dlt log channel default: application-id=cont, context-id=#DFT, log-trace-default-log-level=DEBUG, log-trace-file-path=/var/redirected/, log-trace-log-modes=[CONSOLE, FILE, NETWORK]
          dlt log channel com: application-id=cont, context-id=#COM, log-trace-default-log-level=DEBUG, log-trace-file-path=/var/redirected/, log-trace-log-modes=[CONSOLE, FILE, NETWORK]
          dlt log channel vpa: application-id=cont, context-id=#VPA, log-trace-default-log-level=DEBUG, log-trace-file-path=/var/redirected/, log-trace-log-modes=[CONSOLE, FILE, NETWORK]

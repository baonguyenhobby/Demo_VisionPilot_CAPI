AUTOSAR XML (schema 00049)
package /AvSomeipInstances
  provided someip service instance ProvidedInstance_CameraFrame: service-interface-deployment=CameraFrameService, service-instance-id=3
    someip provided event group ProvidedCameraFrameEventGroup: event-group=CameraFrameEventGroup, multicast-threshold=0
  required someip service instance RequiredInstance_CameraFrame: service-interface-deployment=CameraFrameService, required-minor-version=0, required-service-instance-id=3, version-driven-find-behavior=MINIMUM-MINOR-VERSION
    someip required event group RequiredCameraFrameEventGroup: event-group=CameraFrameEventGroup
  provided someip service instance ProvidedInstance_DrivingState: service-interface-deployment=DrivingStateService, service-instance-id=4
    someip provided event group ProvidedDrivingStateEventGroup: event-group=DrivingStateEventGroup, multicast-threshold=0
  required someip service instance RequiredInstance_DrivingState: service-interface-deployment=DrivingStateService, required-minor-version=0, required-service-instance-id=4, version-driven-find-behavior=MINIMUM-MINOR-VERSION
    someip required event group RequiredDrivingStateEventGroup: event-group=DrivingStateEventGroup
  provided someip service instance ProvidedInstance_Trajectory: service-interface-deployment=TrajectoryService, service-instance-id=5
    someip provided event group ProvidedTrajectoryEventGroup: event-group=TrajectoryEventGroup, multicast-threshold=0
  required someip service instance RequiredInstance_Trajectory: service-interface-deployment=TrajectoryService, required-minor-version=0, required-service-instance-id=5, version-driven-find-behavior=MINIMUM-MINOR-VERSION
    someip required event group RequiredTrajectoryEventGroup: event-group=TrajectoryEventGroup
  required someip service instance RequiredInstance_Trajectory_Viz: service-interface-deployment=TrajectoryService, required-minor-version=0, required-service-instance-id=5, version-driven-find-behavior=MINIMUM-MINOR-VERSION
    someip required event group RequiredTrajectory_VizEventGroup: event-group=TrajectoryEventGroup
  provided someip service instance ProvidedInstance_VehicleStatus: service-interface-deployment=VehicleStatusService, service-instance-id=1
    someip provided event group ProvidedVehicleStatusEventGroup: event-group=VehicleStatusEventGroup, multicast-threshold=0
  required someip service instance RequiredInstance_VehicleStatus: service-interface-deployment=VehicleStatusService, required-minor-version=0, required-service-instance-id=1, version-driven-find-behavior=MINIMUM-MINOR-VERSION
    someip required event group RequiredVehicleStatusEventGroup: event-group=VehicleStatusEventGroup

AUTOSAR XML (schema 00049)
package /AvServiceInterfaces
  4 x service interface, all with major-version=1, minor-version=0:
    CameraFrameService  # Camera frames offered by the Sensing AA as shared-memory references. Carries no pixel data.
      namespaces:
        symbol props av
        symbol props vp
        symbol props cm
      events:
        data FrameEvent: type=FrameDescriptor  # One capture: BEV-warped and plain-resized images, referenced by ring slot. Both travel in one sample because they share an exposure.
    DrivingStateService  # Fused lane-relative state and CIPO estimate produced by the Perception AA.
      namespaces:
        symbol props av
        symbol props vp
        symbol props cm
      events:
        data DrivingStateEvent: type=DrivingState  # Exactly what Planner::compute_plan consumes, less ego speed.
    TrajectoryService  # Planned trajectory from the Planning AA, consumed by Control.
      namespaces:
        symbol props av
        symbol props vp
        symbol props cm
      events:
        data TrajectoryEvent: type=Trajectory  # Acceleration plus the full 20-step steering horizon, so Control has something to follow when planning stops.
    VehicleStatusService  # Ego vehicle state sensed by the Control AA and consumed by Planning.
      namespaces:
        symbol props av
        symbol props vp
        symbol props cm
      events:
        data SpeedEvent: type=VehicleSpeed  # Ego longitudinal speed, m/s.

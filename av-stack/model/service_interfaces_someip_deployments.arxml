AUTOSAR XML (schema 00049)
package /SomeipDeployments
  4 x someip service interface deployment, all with service-interface-version={major-version=1, minor-version=0}:
    CameraFrameService: service-interface=CameraFrameService, service-interface-id=0x1237
      someip event deployment FrameEvent: event=FrameEvent, event-id=0x0004, transport-protocol=UDP
      someip event group CameraFrameEventGroup: event-group-id=1, event=FrameEvent
    DrivingStateService: service-interface=DrivingStateService, service-interface-id=0x1238
      someip event deployment DrivingStateEvent: event=DrivingStateEvent, event-id=0x0005, transport-protocol=UDP
      someip event group DrivingStateEventGroup: event-group-id=1, event=DrivingStateEvent
    TrajectoryService: service-interface=TrajectoryService, service-interface-id=0x1239
      someip event deployment TrajectoryEvent: event=TrajectoryEvent, event-id=0x0006, transport-protocol=UDP
      someip event group TrajectoryEventGroup: event-group-id=1, event=TrajectoryEvent
    VehicleStatusService: service-interface=VehicleStatusService, service-interface-id=0x1235
      someip event deployment SpeedEvent: event=SpeedEvent, event-id=0x0002, transport-protocol=UDP
      someip event group VehicleStatusEventGroup: event-group-id=1, event=SpeedEvent
